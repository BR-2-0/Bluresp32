## sdkconfig.defaults
```kconfig
# --- Bluetooth (NimBLE) ---
CONFIG_BT_ENABLED=y
CONFIG_BT_NIMBLE_ENABLED=y
CONFIG_BT_NIMBLE_MAX_CONNECTIONS=3

# --- USB (TinyUSB) ---
CONFIG_TINYUSB_ENABLED=y
CONFIG_TINYUSB_CDC_ENABLED=n

# --- Main task ---
CONFIG_ESP_MAIN_TASK_STACK_SIZE=8192

# --- Logging ---
CONFIG_LOG_DEFAULT_LEVEL_INFO=y
```
